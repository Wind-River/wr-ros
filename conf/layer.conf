## conf/layer.conf
```bitbake
# We have a conf and classes directory, add to BBPATH
BBPATH =. "${LAYERDIR}:"

# We have a recipe-* directory, add to BBFILES
BBFILES += "${LAYERDIR}/recipes-*/*/*.bb \
            ${LAYERDIR}/recipes-*/*/*.bbappend"

BBFILE_COLLECTIONS += "wrros"
BBFILE_PATTERN_wrros= "^${LAYERDIR}/"
BBFILE_PRIORITY_wrros = "1000"

# Add scripts to PATH
PATH .= ":${LAYERDIR}/scripts"

# Allow the developer to put pre-downloaded src into the downloads directory
# Also allow the user to have bare clones of repositories in the git directory
PREMIRRORS_append = "\
     .*://.*/.* file://${LAYERDIR}/downloads/ \n \
     git://.*/.* git://${LAYERDIR}/git/BASENAME;protocol=file \n \
"

# Enable the wrros layer unconditionally if the whitelist in enabled
PNWHITELIST_LAYERS_remove = "wrros"

LAYERSERIES_COMPAT_wrros = "hardknott"
```
